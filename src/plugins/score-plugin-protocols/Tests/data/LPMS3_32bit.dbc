VERSION ""

NS_ :

BS_:

BU_:

BO_ 3221225472 VECTOR__INDEPENDENT_SIG_MSG: 0 Vector__XXX
 SG_ Temperature : 0|32@1- (1,0) [0|0] "d" Vector__XXX
 SG_ Pressure : 0|32@1- (1,0) [0|0] "kPa" Vector__XXX
 SG_ Lin_AccZ : 0|32@1- (1,0) [0|0] "g" Vector__XXX
 SG_ Lin_AccY : 0|32@1- (1,0) [0|0] "g" Vector__XXX
 SG_ Lin_AccX : 0|32@1- (1,0) [0|0] "g" Vector__XXX
 SG_ EulerZ : 0|32@1- (1,0) [0|0] "d" Vector__XXX
 SG_ EulerY : 0|32@1- (1,0) [0|0] "d" Vector__XXX
 SG_ EulerX : 0|32@1- (1,0) [0|0] "d" Vector__XXX
 SG_ QuaternionZ : 0|32@1- (1,0) [0|0] "" Vector__XXX
 SG_ QuaternionY : 0|32@1- (1,0) [0|0] "" Vector__XXX
 SG_ QuaternionX : 0|32@1- (1,0) [0|0] "" Vector__XXX
 SG_ QuaternionW : 0|32@1- (1,0) [0|0] "" Vector__XXX
 SG_ Angular_RateZ : 0|32@1- (1,0) [0|0] "d/s" Vector__XXX
 SG_ Angular_RateY : 0|32@1- (1,0) [0|0] "d/s" Vector__XXX
 SG_ Angular_RateX : 0|32@1- (1,0) [0|0] "d/s" Vector__XXX
 SG_ Mag_CalibratedZ : 0|32@1- (1,0) [0|0] "uT" Vector__XXX
 SG_ Mag_CalibratedY : 0|32@1- (1,0) [0|0] "uT" Vector__XXX
 SG_ Mag_CalibratedX : 0|32@1- (1,0) [0|0] "uT" Vector__XXX
 SG_ Mag_RawZ : 0|32@1- (1,0) [0|0] "uT" Vector__XXX
 SG_ Mag_RawY : 0|32@1- (1,0) [0|0] "uT" Vector__XXX
 SG_ Mag_RawX : 0|32@1- (1,0) [0|0] "uT" Vector__XXX
 SG_ GyroII_Align_CalibratedZ : 0|32@1- (1,0) [0|0] "d/s" Vector__XXX
 SG_ GyroII_Align_CalibratedY : 0|32@1- (1,0) [0|0] "d/s" Vector__XXX
 SG_ GyroII_Align_CalibratedX : 0|32@1- (1,0) [0|0] "d/s" Vector__XXX
 SG_ GyroII_Bias_CalibratedZ : 0|32@1- (1,0) [0|0] "d/s" Vector__XXX
 SG_ GyroII_Bias_CalibratedY : 0|32@1- (1,0) [0|0] "d/s" Vector__XXX
 SG_ GyroII_Bias_CalibratedX : 0|32@1- (1,0) [0|0] "d/s" Vector__XXX
 SG_ GyroII_RawZ : 0|32@1- (1,0) [0|0] "d/s" Vector__XXX
 SG_ GyroII_RawY : 0|32@1- (1,0) [0|0] "d/s" Vector__XXX
 SG_ GyroII_RawX : 0|32@1- (1,0) [0|0] "d/s" Vector__XXX
 SG_ Acc_CalibratedZ : 0|32@1- (1,0) [0|0] "g" Vector__XXX
 SG_ Acc_CalibratedY : 0|32@1- (1,0) [0|0] "g" Vector__XXX
 SG_ Acc_CalibratedX : 0|32@1- (1,0) [0|0] "g" Vector__XXX
 SG_ Acc_RawZ : 0|32@1- (1,0) [0|0] "g" Vector__XXX
 SG_ Acc_RawY : 0|32@1- (1,0) [0|0] "g" Vector__XXX
 SG_ Acc_RawX : 0|32@1- (1,0) [0|0] "g" Vector__XXX

BO_ 1793 Heatbeat: 8 Vector__XXX

BO_ 1153 PDO4_Transmit: 8 Vector__XXX
 SG_ Mag_CalibratedX : 32|32@1- (1,0) [0|0] "uT" Vector__XXX
 SG_ Mag_CalibratedZ : 0|32@1- (1,0) [0|0] "uT" Vector__XXX

BO_ 897 PDO3_Transmit: 8 Vector__XXX
 SG_ GyroII_Align_CalibratedZ : 32|32@1- (1,0) [0|0] "d/s" Vector__XXX
 SG_ GyroII_Align_CalibratedY : 0|32@1- (1,0) [0|0] "d/s" Vector__XXX

BO_ 641 PDO2_Transmit: 8 Vector__XXX
 SG_ GyroII_Align_CalibratedX : 32|32@1- (1,0) [0|0] "d/s" Vector__XXX
 SG_ Acc_CalibratedZ : 0|32@1- (1,0) [0|0] "g" Vector__XXX

BO_ 385 PDO1_Transmit: 8 Vector__XXX
 SG_ Acc_CalibratedY : 32|32@1- (1,0) [0|0] "g" Vector__XXX
 SG_ Acc_CalibratedX : 0|32@1- (1,0) [0|0] "g" Vector__XXX

CM_ BO_ 3221225472 "This is a message for not used signals, created by Vector CANdb++ DBC OLE DB Provider.";
BA_DEF_  "BusType" STRING ;
BA_DEF_DEF_  "BusType" "CAN";
